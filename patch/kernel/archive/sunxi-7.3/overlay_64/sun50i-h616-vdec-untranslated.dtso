// SPDX-License-Identifier: (GPL-2.0+ OR MIT)
/*
 * Run the H616 video engine (Cedrus) without IOMMU translation: its two
 * masters stay in bypass and its buffers come physically contiguous
 * from CMA. 4K 10-bit VP9 into P010 then decodes at 60+ fps (the VE's
 * P010 write misses the IOMMU TLB otherwise). Needs a large CMA area on
 * the kernel command line (cma= in extraargs of armbianEnv.txt, size in
 * the image documentation). Every other device stays behind the IOMMU.
 */
/dts-v1/;
/plugin/;

/ {
	compatible = "allwinner,sun50i-h616";

	fragment@0 {
		target-path = "/soc/video-codec@1c0e000";
		__overlay__ {
			iommus;
		};
	};
};
