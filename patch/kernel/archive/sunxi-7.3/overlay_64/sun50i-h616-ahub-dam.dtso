/dts-v1/;
/plugin/;

/*
 * Audio hub digital audio mixers (DAM0/DAM1) and source routing as the
 * control-only sound card "ahubdam" (Allwinner AHUB driver,
 * CONFIG_SND_SOC_SUNXI_AHUB_DAM). The card has no PCM device; it holds
 * the "APBIF0-2 Src Select", "I2S0-3 Src Select" and "DAM0C0-2 /
 * DAM1C0-2 Src Select" controls that route and mix the hub's streams
 * (for example I2S3 from the i2s3-ph overlay mixed into the HDMI output).
 * The vendor BSP enables this card on every H616 board; the Orange Pi
 * Zero2 device tree enables it already, this overlay is for other boards.
 *
 * Uses no pins. Combine with i2s3-ph (or another AHUB interface) to
 * have more than the HDMI stream to route.
 */

/ {
	compatible = "allwinner,sun50i-h616", "allwinner,sun50i-h618";

	fragment@0 {
		target = <&ahub_dam_mach>;
		__overlay__ {
			status = "okay";
		};
	};
};
