// SPDX-License-Identifier: (GPL-2.0+ OR MIT)
/*
 * TRIAL ONLY (never in an image): hand the H616 Mali-G31 to Arm's kbase instead of panfrost.
 * panfrost matches "arm,mali-bifrost" and "allwinner,sun50i-h616-mali"; kbase also matches
 * "arm,mali-midgard", which panfrost does not, so this compatible alone keeps panfrost off the GPU.
 * Everything else (reg, 3 IRQs job/mmu/gpu, clocks core+bus, RST_BUS_GPU, prcm_ppu power domain,
 * mali-supply = dcdcc, operating-points-v2 = gpu_opp_table) stays as in sun50i-h616.dtsi / the board dts.
 */
/dts-v1/;
/plugin/;

/ {
	compatible = "allwinner,sun50i-h616";

	fragment@0 {
		target = <&gpu>;
		__overlay__ {
			compatible = "arm,mali-midgard";
		};
	};
};
